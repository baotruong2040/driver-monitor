## sdkconfig.defaults
```kconfig
CONFIG_SPIRAM=y
CONFIG_SPIRAM_MODE_OCT=y
CONFIG_SPIRAM_SPEED_80M=y
CONFIG_SPIRAM_BOOT_INIT=y
CONFIG_SPIRAM_USE_MALLOC=y
CONFIG_ESPTOOLPY_FLASHSIZE_16MB=y
CONFIG_PARTITION_TABLE_CUSTOM=y
CONFIG_PARTITION_TABLE_CUSTOM_FILENAME="partitions_16mb.csv"
CONFIG_ESPTOOLPY_FLASHMODE_QIO=y
CONFIG_ESPTOOLPY_FLASHFREQ_80M=y
# CONFIG_CAMERA_PSRAM_DMA is not set
CONFIG_CAMERA_CORE1=y
CONFIG_ESP_DEFAULT_CPU_FREQ_MHZ_240=y

# CONFIG_COMPILER_OPTIMIZATION_DEBUG is not set
CONFIG_COMPILER_OPTIMIZATION_SIZE=y
CONFIG_ESP32S3_INSTRUCTION_CACHE_16KB=y
# CONFIG_ESP32S3_INSTRUCTION_CACHE_32KB is not set
CONFIG_ESP32S3_INSTRUCTION_CACHE_SIZE=0x4000
# CONFIG_ESP32S3_DATA_CACHE_16KB is not set
CONFIG_ESP32S3_DATA_CACHE_32KB=y
# CONFIG_ESP32S3_DATA_CACHE_64KB is not set
CONFIG_ESP32S3_DATA_CACHE_SIZE=0x8000
CONFIG_ESP32S3_DATA_CACHE_LINE_32B=y
# CONFIG_ESP32S3_DATA_CACHE_LINE_64B is not set
CONFIG_ESP32S3_DATA_CACHE_LINE_SIZE=32

# Native USB is owned by UVC. Keep diagnostics on UART0.
CONFIG_ESP_CONSOLE_UART_DEFAULT=y
CONFIG_ESP_CONSOLE_SECONDARY_NONE=y
# CONFIG_ESP_CONSOLE_SECONDARY_USB_SERIAL_JTAG is not set
CONFIG_UVC_MODE_BULK_CAM1=y
# CONFIG_UVC_MODE_ISOC_CAM1 is not set
CONFIG_FORMAT_MJPEG_CAM1=y
CONFIG_FRAMESIZE_HD=y
CONFIG_UVC_CAM1_FRAMERATE=30
# CONFIG_UVC_CAM1_MULTI_FRAMESIZE is not set
CONFIG_TUSB_PRODUCT="ESP32-S3 AI Camera"
CONFIG_TUSB_SERIAL_NUM="AI-DETECT-001"
CONFIG_UVC_TINYUSB_TASK_CORE=0
CONFIG_UVC_CAM1_TASK_CORE=1
CONFIG_FREERTOS_HZ=1000

# CONFIG_FRAMESIZE_FHD is not set
```
